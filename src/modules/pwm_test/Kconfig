## src/modules/pwm_test/Kconfig
```kconfig
menuconfig MODULES_PWM_TEST
        bool "pwm_test"
        default n
        ---help---
                Enable support for pwm_test
```

## src/modules/rc_test/Kconfig
```kconfig
menuconfig MODULES_RC_TEST
        bool "rc_test"
        default n
        ---help---
                Enable support for rc_test
```
